## targets/waveshare_p4/sdkconfig.defaults
```kconfig
CONFIG_IDF_TARGET="esp32p4"
CONFIG_ESP32P4_REV_MIN_300=y
CONFIG_ESPTOOLPY_FLASHSIZE_32MB=y
CONFIG_SPIRAM=y
CONFIG_SPIRAM_SPEED_250M=y
CONFIG_ESP_MAIN_TASK_STACK_SIZE=24576
CONFIG_FREERTOS_HZ=1000
CONFIG_COMPILER_CXX_EXCEPTIONS=n
CONFIG_COMPILER_CXX_RTTI=n
# Keep assertion checks, but never print exception registers/stack memory.
CONFIG_COMPILER_OPTIMIZATION_ASSERTIONS_ENABLE=n
CONFIG_COMPILER_OPTIMIZATION_ASSERTIONS_SILENT=y
CONFIG_ESP_SYSTEM_PANIC_PRINT_REBOOT=n
CONFIG_ESP_SYSTEM_PANIC_SILENT_REBOOT=y
CONFIG_ESP_SYSTEM_PANIC_REBOOT_DELAY_SECONDS=0
# A debugger must not change a panic into a halt with secrets retained.
CONFIG_ESP_DEBUG_OCDAWARE=n
CONFIG_FREERTOS_DEBUG_OCDAWARE=n
CONFIG_MBEDTLS_GCM_C=y
CONFIG_FATFS_LFN_HEAP=y
CONFIG_FATFS_MAX_LFN=64
CONFIG_LV_USE_QRCODE=y
CONFIG_LV_FONT_MONTSERRAT_18=y
CONFIG_LV_FONT_MONTSERRAT_20=y
CONFIG_LV_FONT_MONTSERRAT_22=y
CONFIG_LV_FONT_MONTSERRAT_24=y
CONFIG_LV_FONT_MONTSERRAT_28=y
CONFIG_LV_FONT_MONTSERRAT_32=y
CONFIG_LV_USE_LOG=n
CONFIG_LV_USE_PERF_MONITOR=n
CONFIG_LV_USE_CUSTOM_MALLOC=y
CONFIG_SPIRAM_USE_MALLOC=y
CONFIG_BSP_ERROR_CHECK=n
CONFIG_ESP_VIDEO_ENABLE_MIPI_CSI_VIDEO_DEVICE=y
CONFIG_CAMERA_OV5647=y
CONFIG_CAMERA_OV5647_MIPI_RAW8_800X1280_50FPS=y
CONFIG_CAMERA_OV5647_MIPI_DEFAULT_FMT_RAW8_800X1280_50FPS=y
CONFIG_ESP_VIDEO_ENABLE_ISP_PIPELINE_CONTROLLER=y
CONFIG_IDF_EXPERIMENTAL_FEATURES=y
CONFIG_BSP_I2C_CLK_SPEED_HZ=400000
CONFIG_BSP_LCD_DPI_BUFFER_NUMS=3
CONFIG_BSP_LCD_COLOR_FORMAT_RGB565=y
CONFIG_BSP_SD_FORMAT_ON_MOUNT_FAIL=n
CONFIG_BSP_SPIFFS_FORMAT_ON_MOUNT_FAIL=n
CONFIG_CODEC_ES7210_SUPPORT=y
CONFIG_ESP_VIDEO_ENABLE_DVP_VIDEO_DEVICE=n
CONFIG_ESP_VIDEO_ENABLE_SPI_VIDEO_DEVICE=n
CONFIG_ESP_VIDEO_ENABLE_USB_UVC_VIDEO_DEVICE=n
CONFIG_ESP_VIDEO_ENABLE_HW_JPEG_VIDEO_DEVICE=n
CONFIG_ESP_VIDEO_ENABLE_HW_H264_VIDEO_DEVICE=n
CONFIG_ESP_VIDEO_ENABLE_CAMERA_MOTOR_CONTROLLER=n
```
